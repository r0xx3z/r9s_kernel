## arch/arm64/configs/vendor/universal2100_gki_defconfig
```kconfig
CONFIG_LOG_BUF_SHIFT=21
CONFIG_ARCH_EXYNOS=y
CONFIG_SOC_EXYNOS2100=y

# CONFIG_UNMAP_KERNEL_AT_EL0 is not set
# CONFIG_HARDEN_BRANCH_PREDICTOR is not set

CONFIG_PM_DEBUG=y
CONFIG_DPM_WATCHDOG=y
CONFIG_DPM_WATCHDOG_TIMEOUT=10
CONFIG_FOTA_LIMIT=y
CONFIG_CPU_IDLE_GOV_TEO=y
CONFIG_CPU_FREQ_GOV_ENERGYSTEP=y
CONFIG_ARM_FREQ_QOS_TRACER=m
CONFIG_ARM_EXYNOS_ACME=m
CONFIG_ARM_EXYNOS_DSU_FREQ=m
CONFIG_ARM64_CRYPTO=y
# CONFIG_CFI_CLANG is not set
CONFIG_TRIM_UNUSED_KSYMS=y
CONFIG_UNUSED_KSYMS_WHITELIST="gki/abi_symbollist.raw"

CONFIG_SCHED_EMS=y
CONFIG_SCHED_EMS_TUNE=y
CONFIG_SCHED_USE_FLUID_RT=y

CONFIG_BLK_SEC_STATS=m
CONFIG_MQ_IOSCHED_SSG=m
CONFIG_MEMORY_HOTREMOVE=y
CONFIG_TRANSPARENT_HUGEPAGE=y
# CONFIG_TRANSPARENT_HUGE_PAGECACHE is not set
CONFIG_KZEROD=y
CONFIG_HUGEPAGE_POOL=y
CONFIG_HUGEPAGE_POOL_ALLOW_ALL=y
CONFIG_HPA=y
CONFIG_ARCH_SUPPORTS_SPECULATIVE_PAGE_FAULT=y
CONFIG_XFRM_MIGRATE=y
CONFIG_TCP_CONG_ADVANCED=y
CONFIG_TCP_CONG_BIC=y
CONFIG_TCP_CONG_BBR=y
CONFIG_NETFILTER_XT_TARGET_LOG=y
CONFIG_IP_NF_MATCH_RPFILTER=y
CONFIG_NET_SCH_PRIO=y
CONFIG_NET_CLS_BASIC=y
CONFIG_NET_ACT_MIRRED=y
CONFIG_KNOX_NCM=y
CONFIG_BT_BCM43XX=m
CONFIG_NFC=y
CONFIG_SAMSUNG_NFC=m
CONFIG_ESE_USE_TZ_API=y
CONFIG_SEC_NFC_LOGGER=y
CONFIG_NFC_PN547=y
CONFIG_NFC_FEATURE_SN100U=y
CONFIG_NFC_PN547_ESE_SUPPORT=y
CONFIG_STAR_K250A_LEGO=m
# CONFIG_PCIEPORTBUS is not set
CONFIG_PCI_EXYNOS=m
CONFIG_PCI_EXYNOS_2100=m
CONFIG_EXYNOS_PCIE_GEN2_S2MPU=m
CONFIG_CONNECTOR=y
CONFIG_SEC_STI=y
CONFIG_EXYNOS_PASR=y
CONFIG_SPU_VERIFY=m
CONFIG_DEV_RIL_BRIDGE=m
# CONFIG_TRUSTONIC_TEE is not set
CONFIG_VISION_SUPPORT=y
CONFIG_USE_MUIC=y
CONFIG_SENSORS_SYSFS=y
CONFIG_SENSORS_SSP=y
CONFIG_SENSORS_SSP_BBD=y
CONFIG_SENSORS_DYNAMIC_SENSORLIST=y
CONFIG_SENSORS_SSP_SENSORHUB=y
CONFIG_SENSORS_SSP_MOBEAM=y
CONFIG_SENSORS_SSP_LIGHT_REPORT_LUX=y
CONFIG_SENSORS_SSP_LIGHT_ADDING_LUMINANCE=y
CONFIG_SENSORS_SSP_LIGHT_MAX_ATIME_2BYTE=y
CONFIG_SENSORS_SSP_LIGHT_MAX_GAIN_2BYTE=y
CONFIG_SENSORS_SSP_IRDATA_FOR_CAMERA=y
CONFIG_SENSORS_MULTIPLE_GLASS_TYPE=y
CONFIG_SENSORS_SSP_INTERRUPT_GYRO_SENSOR=y
CONFIG_SENSORS_SSP_HIFI_BATCHING=y
CONFIG_SSP_MOTOR_CALLBACK=y
CONFIG_SENSORS_SSP_THERMISTOR=y
CONFIG_SSP_SUPPORT_MAGNETIC_OVERFLOW=y
CONFIG_SENSORS_SSP_LIGHT_LUX_RAW=y
CONFIG_SENSORS_SSP_PROX_LIGHT_DIFF=y
CONFIG_SAMSUNG_TUI=m
CONFIG_TZDEV=m
CONFIG_TZDEV_IWI_EVENT=900
CONFIG_TZDEV_IWI_PANIC=901
CONFIG_TZDEV_SWD_PANIC_IS_CRITICAL=y
CONFIG_TZLOG=y
CONFIG_TZLOG_PG_CNT=8
CONFIG_TZDEV_SK_MULTICORE=y
CONFIG_ION_FD2PHYS_VARIANT=1
CONFIG_TZIRS=y
CONFIG_TZ_BOOT_LOG=y
CONFIG_TEEGRIS_VERSION=4
CONFIG_EXYNOS_DSP=m
CONFIG_EXYNOS_DSP_HW_O1=y
CONFIG_EXYNOS_NPU=m
CONFIG_NPU_INTERFACE=y
CONFIG_NPU_HARDWARE=y
CONFIG_NPU_USE_VOTF=y
CONFIG_SEC_ABC=m
CONFIG_SEC_ABC_MOTTO=m
CONFIG_SEC_ABC_HUB=m
CONFIG_SEC_ABC_HUB_COND=y
CONFIG_SEC_ABC_HUB_BOOTC=y
CONFIG_EXYNOS_BTS=m
CONFIG_MUIC_NOTIFIER=m
CONFIG_MUIC_SUPPORT_PDIC=y
CONFIG_HICCUP_CHARGER=y
CONFIG_MUIC_AFC_RETRY=y
CONFIG_UFS_SRPMB=m
CONFIG_SCSI_UFS_EXYNOS=m
CONFIG_SEC_UFS_WB_FEATURE=m
CONFIG_DM_ANDROID_VERITY_AT_MOST_ONCE_DEFAULT_ENABLED=y
CONFIG_USB_RTL8150=m
# CONFIG_USB_NET_CDC_EEM is not set
CONFIG_USB_NET_CDC_EEM=m
CONFIG_USB_NET_CDC_NCM=m
CONFIG_USB_NET_SMSC75XX=m
CONFIG_USB_NET_SMSC95XX=m
CONFIG_USB_NET_NET1080=m
CONFIG_WLAN_VENDOR_DUMP_ENABLE=y
CONFIG_SUPPORT_DROPDUMP=m
CONFIG_KEYBOARD_S2MPS23=m
CONFIG_INPUT_SEC_INPUT=m
CONFIG_SEC_DEBUG_TSP_LOG=m
CONFIG_INPUT_TOUCHSCREEN_TCLMV2=m
CONFIG_INPUT_SEC_SECURE_TOUCH=m
CONFIG_TOUCHSCREEN_DUMP_MODE=m
CONFIG_INPUT_SEC_NOTIFIER=m
CONFIG_SEC_INPUT_BOOSTER_SLSI=y
CONFIG_SENSORS_FINGERPRINT=m
CONFIG_FINGERPRINT_SECURE=y
CONFIG_SENSORS_FINGERPRINT_MODULE=y
CONFIG_SENSORS_FINGERPRINT_LSI=y
CONFIG_SEC_VIBRATOR=m
CONFIG_SEC_VIB_NOTIFIER=y
CONFIG_INPUT_HALL_IC=m
# CONFIG_SERIAL_8250_DW is not set
CONFIG_SERIAL_EXYNOS=m
CONFIG_I2C_CHARDEV=m
CONFIG_I2C_EXYNOS5=m
CONFIG_EXYNOS_ACPM_MFD_BUS=m
CONFIG_SPI_S3C64XX=m
CONFIG_SPI_SPIDEV=m
CONFIG_PINCTRL_SAMSUNG=m
CONFIG_POWER_RESET_EXYNOS=m
CONFIG_DIRECT_CHARGING=m
CONFIG_BATTERY_SAMSUNG=m
CONFIG_STEP_CHARGING=y
CONFIG_ENABLE_FULL_BY_SOC=y
CONFIG_SEC_PD=m
CONFIG_BATTERY_CISD=y
CONFIG_AFC_CHARGER_MODE=y
CONFIG_BATTERY_AGE_FORECAST=y
CONFIG_PREVENT_USB_CONN_OVERHEAT=y
CONFIG_BATTERY_GKI=y
CONFIG_WIRELESS_TX_MODE=y
CONFIG_CHARGER_MAX77705=m
CONFIG_FUELGAUGE_MAX77705=m
CONFIG_WIRELESS_CHARGER_MFC=m
CONFIG_WIRELESS_AUTH=y
CONFIG_WIRELESS_CHARGER_HIGH_VOLTAGE=y
CONFIG_WIRELESS_FIRMWARE_UPDATE=y
CONFIG_WIRELESS_IC_PARAM=y
CONFIG_TX_GEAR_PHM_VOUT_CTRL=y
# CONFIG_DEVFREQ_THERMAL is not set
CONFIG_EXYNOS_THERMAL_V2=m
CONFIG_EXYNOS_ACPM_THERMAL=m
CONFIG_GPU_THERMAL=m
CONFIG_ISP_THERMAL=m
CONFIG_DEV_THERMAL=m
CONFIG_EXYNOS_CPU_THERMAL=m
CONFIG_S3C2410_WATCHDOG=m
CONFIG_S3C2410_SHUTDOWN_REBOOT=y
CONFIG_MFD_MAX77705=m
CONFIG_MFD_S2MPS23=m
CONFIG_MFD_S2MPS24=m
# CONFIG_REGULATOR is not set
# CONFIG_MEDIA_CAMERA_SUPPORT is not set
CONFIG_DRV_SAMSUNG_PMIC=m
CONFIG_REGULATOR_S2MPS23=m
CONFIG_REGULATOR_S2MPS24=m
CONFIG_REGULATOR_S2MPB03=m
CONFIG_VIDEO_EXYNOS_REPEATER=m
CONFIG_VIDEO_EXYNOS_TSMUX=m
CONFIG_VIDEO_EXYNOS_MFC=m
CONFIG_VIDEO_EXYNOS_PABLO_ISP=m
CONFIG_CAMERA_VENDER_MCD=y
CONFIG_CAMERA_EEPROM_SUPPORT_REAR=m
CONFIG_CAMERA_EEPROM_SUPPORT_FRONT=m
CONFIG_OIS_USE=y
CONFIG_AF_HOST_CONTROL=y
CONFIG_FLASH_CURRENT_CHANGE_SUPPORT=y
CONFIG_USE_SIGNED_BINARY=y
CONFIG_CAMERA_USE_INTERNAL_MCU=y
CONFIG_CAMERA_FLASH_KTD2692_OBJ=m
CONFIG_VIDEO_EXYNOS_CAMERA_POSTPROCESS=m
CONFIG_CAMERA_PP_GDC_V4_1_0_OBJ=m
CONFIG_VIDEO_EXYNOS_CAMERA_POSTPROCESS_VOTF=m
CONFIG_VIDEO_EXYNOS_CAMERA_POSTPROCESS_PD_MGR=m
CONFIG_VIDEO_EXYNOS_SCALER=m
CONFIG_VIDEO_EXYNOS_SMFC=m
CONFIG_EXYNOS_SOC_NAME="exynos"
# CONFIG_MALI_GATOR_SUPPORT is not set
CONFIG_EXYNOS_DPU30=m
CONFIG_EXYNOS_DISPLAYPORT_MODULE=m
CONFIG_EXYNOS_DECON_DQE=y
CONFIG_EXYNOS_WINDOW_UPDATE=y
CONFIG_EXYNOS_HIBERNATION=y
CONFIG_EXYNOS_HIBERNATION_EARLY_WAKEUP=y
CONFIG_EXYNOS_DOZE=y
CONFIG_EXYNOS_DOZE_HIBERNATION=y
CONFIG_EXYNOS_MULTIRESOLUTION=y
CONFIG_DECON_BTS_LEGACY=y
CONFIG_DECON_BTS_VRR_ASYNC=y
CONFIG_EXYNOS_FREQ_HOP=y
CONFIG_EXYNOS_PLL_SLEEP=y
CONFIG_EXYNOS_EWR=y
CONFIG_EXYNOS_SUPPORT_READBACK=y
CONFIG_EXYNOS_SUPPORT_WB=y
CONFIG_EXYNOS_SUPPORT_HWFC=y
CONFIG_EXYNOS_DMA_DSIMFC=y
CONFIG_EXYNOS_SUPPORT_VOTF_IN=y
CONFIG_EXYNOS_SUPPORT_8K_SPLIT=y
CONFIG_EXYNOS_SBWC_LIBREQ=y
CONFIG_USE_DISPLAYPORT_PDIC_EVENT_QUEUE=y
CONFIG_MCDHDR=y
CONFIG_MCD_PANEL=m
CONFIG_EXYNOS_DECON_MDNIE_LITE=y
CONFIG_SUPPORT_DSU=y
CONFIG_SUPPORT_AOD_BL=y
CONFIG_SUPPORT_GRAM_CHECKSUM=y
CONFIG_SUPPORT_CCD_TEST=y
CONFIG_DISPLAY_USE_INFO=y
CONFIG_DYNAMIC_MIPI=y
CONFIG_PANEL_DISPLAY_MODE=y
CONFIG_PANEL_VRR_BRIDGE=y
CONFIG_SEC_DISPLAYPORT_EXT_FUNCTION=m
CONFIG_SEC_DISPLAYPORT_LOGGER=y
CONFIG_SEC_DISPLAYPORT_BIGDATA=y
CONFIG_SEC_DISPLAYPORT=y
CONFIG_FB=m
CONFIG_FB_MODE_HELPERS=y
CONFIG_SND_EXYNOS_USB_AUDIO=y
CONFIG_SND_EXYNOS_USB_AUDIO_MODULE=m
CONFIG_SND_SOC_SAMSUNG=m
CONFIG_SND_SOC_SAMSUNG_DISPLAYPORT=m
CONFIG_SND_SOC_SAMSUNG_EXYNOS2100_CS35L41_I2C=m
CONFIG_SND_SOC_SAMSUNG_UNBOUND_PRINCE=m
CONFIG_SND_SOC_SAMSUNG_AUDIO=m
CONFIG_SND_SOC_CIRRUS_AMP=m
CONFIG_HID_SAMSUNG=y
CONFIG_USB_ANNOUNCE_NEW_DEVICES=y
CONFIG_USB_HOST_CERTIFICATION=y
CONFIG_USB_XHCI_HCD=m
CONFIG_USB_ACM=m
CONFIG_USB_PRINTER=m
CONFIG_USB_WDM=m
CONFIG_USB_HOST_NOTIFY=y
CONFIG_USB_NOTIFY_LAYER=m
CONFIG_USB_NOTIFIER=m
CONFIG_USB_DEBUG_DETAILED_LOG=y
CONFIG_USB_EXTERNAL_NOTIFY=y
CONFIG_USB_NOTIFY_PROC_LOG=y
CONFIG_USB_HOST_SAMSUNG_FEATURE=y
CONFIG_USB_HW_PARAM=y
CONFIG_USB_INTERFACE_LPM_LIST=y
CONFIG_USB_AUDIO_ENHANCED_DETECT_TIME=y
CONFIG_GKI_USB=y
CONFIG_USB_DWC3=y
CONFIG_USB_DWC3_MODULE=m
CONFIG_USB_PORT_POWER_OPTIMIZATION=y
CONFIG_USB_EXYNOS_TPMON=y
CONFIG_USB_EXYNOS_TPMON_MODULE=m
CONFIG_USB_DWC3_HOST=y
CONFIG_USB_DWC3_GADGET=y
CONFIG_USB_SERIAL=m
CONFIG_USB_SERIAL_FTDI_SIO=m
CONFIG_USB_SERIAL_PL2303=m
CONFIG_USB_EHSET_TEST_FIXTURE=y
CONFIG_USB_LINK_LAYER_TEST=y
CONFIG_USB_CONFIGFS_F_DM=m
CONFIG_USB_CONFIGFS_F_MTP=m
CONFIG_USB_CONFIGFS_F_PTP=m
CONFIG_USB_CONFIGFS_F_CONN_GADGET=m
CONFIG_USB_CONFIGFS_F_SS_MON_GADGET=m
CONFIG_USB_RNDIS_MULTIPACKET=y
CONFIG_SUPPORT_USB_TYPEC_OPS=y
CONFIG_USB_TYPEC_MANAGER_NOTIFIER=m
CONFIG_IF_CB_MANAGER=m
CONFIG_PDIC_NOTIFIER=m
CONFIG_USB_ARCH_EXYNOS=y
CONFIG_CCIC_MAX77705=m
CONFIG_MAXIM_CCIC_ALTERNATE_MODE=y
CONFIG_MAX77705_FW_PID03_SUPPORT=y
CONFIG_MUIC_MAX77705=y
CONFIG_HV_MUIC_MAX77705_AFC=y
CONFIG_MUIC_MAX77705_PDIC=y
CONFIG_AFC=y
CONFIG_MMC_DW=m
CONFIG_MMC_DW_EXYNOS=m
CONFIG_RTC_DRV_S2MPS23=m
CONFIG_RTC_DRV_S3C=m
CONFIG_DMA_BUF_CONTAINER=m
CONFIG_SAMSUNG_LMKD_DEBUG=y
CONFIG_SAMSUNG_FREECESS=y
CONFIG_ION_EXYNOS_CARVEOUT_HEAP=y
CONFIG_ION_EXYNOS_CMA_HEAP=y
CONFIG_ION_EXYNOS=m
CONFIG_ION_EXYNOS_HPA_HEAP=y
CONFIG_ANDROID_SWITCH=m
CONFIG_SEC_REBOOT=m
CONFIG_SEC_PMIC_PWRKEY_DTNAME="s2mps23-keys"
CONFIG_SEC_KEY_NOTIFIER=m
CONFIG_SEC_PARAM=m
CONFIG_SEC_BOOTSTAT=m
CONFIG_DRV_SAMSUNG=m
CONFIG_ARGOS=m
CONFIG_ARGOS_CLUSTER_NUM=3
CONFIG_SAMSUNG_PRODUCT_SHIP=y
CONFIG_SEC_DEBUG=y
CONFIG_SEC_DEBUG_BASE=m
CONFIG_SEC_DEBUG_BASE_BUILT_IN=y
CONFIG_SEC_DEBUG_AUTO_COMMENT=y
CONFIG_SEC_DEBUG_MODE=m
CONFIG_SEC_DEBUG_EXTRA_INFO=m
CONFIG_SEC_DEBUG_EXTRA_INFO_BUILT_IN=y
CONFIG_SEC_DEBUG_HW_PARAM=m
CONFIG_SEC_DEBUG_RESET_REASON=m
CONFIG_SEC_DEBUG_MEMTAB=y
CONFIG_SEC_DEBUG_HIST_LOG=m
CONFIG_SEC_DEBUG_SUMMARY_LOG=m
CONFIG_SEC_DEBUG_PRINT_PCLR=y
CONFIG_SEC_DEBUG_BUG_ON_SLUB_CORRUPTION=y
CONFIG_SEC_DEBUG_AVOID_UNNECESSARY_TRAP=y
CONFIG_SEC_DEBUG_WORKQUEUE_LOCKUP_PANIC=y
CONFIG_SEC_DEBUG_EXCEPTION_STACK=y
CONFIG_SEC_DEBUG_WATCHDOGD_FOOTPRINT=m
CONFIG_SEC_DEBUG_UNFROZEN_TASK=y
CONFIG_SEC_DEBUG_FAULT_MSG_ADV=y
CONFIG_SEC_DEBUG_EMERG_WDT_CALLER=y
CONFIG_SEC_DEBUG_DTASK=y
CONFIG_SEC_DEBUG_TASK_IN_STATE_INFO=y
CONFIG_SEC_DEBUG_SOFTDOG_PWDT=m
CONFIG_SEC_DEBUG_WQ_LOCKUP_INFO=m
CONFIG_SEC_DEBUG_SOFTDOG=m
CONFIG_SEC_DEBUG_QSPIN_OWNER=y
CONFIG_SEC_DUMP_SINK=m
CONFIG_SEC_DEBUG_LOGBUF_IF=m
CONFIG_SEC_DEBUG_HANDLE_BAD_STACK=y
CONFIG_SEC_DEBUG_HARDLOCKUP_INFO=m
CONFIG_SEC_DEBUG_SCHED_REPORT=m
CONFIG_VBUS_NOTIFIER=m
CONFIG_SEC_PM=y
CONFIG_SEC_PM_DEBUG=m
CONFIG_SEC_PM_BIGDATA=y
CONFIG_SEC_PM_CPUFREQ=m
CONFIG_SEC_PM_LOG=m
CONFIG_SEC_PM_THERMISTOR=m
CONFIG_SEC_WAKEUP_CPU_ALLOCATOR=m
CONFIG_COMMON_CLK_SAMSUNG=m
CONFIG_CLKSRC_EXYNOS_MCT=m
CONFIG_SAMSUNG_IOMMU=m
CONFIG_ECT=m
CONFIG_EXYNOS_PM=m
CONFIG_EXYNOS_CHIPID_V2=m
CONFIG_EXYNOS_PMU_IF=m
CONFIG_CAL_IF=m
CONFIG_EXYNOS_FLEXPMU_DBG=m
CONFIG_USI_V2=m
CONFIG_CMU_EWF=m
CONFIG_EXYNOS_ACPM=m
CONFIG_ACPM_DVFS=m
CONFIG_EXYNOS_PD=m
CONFIG_EXYNOS_PD_DBG=m
CONFIG_EXYNOS_EL2=m
CONFIG_EXYNOS_S2MPU=m
CONFIG_EXYNOS_SSP=m
CONFIG_EXYNOS_CPUPM=m
CONFIG_EXYNOS_CPUHP=m
CONFIG_EXYNOS_UFCC=m
CONFIG_EXYNOS_SCI=m
# CONFIG_USE_LLC_LOG is not set
CONFIG_EXYNOS_SCI_DBG=m
# CONFIG_USE_PPC_LOG is not set
CONFIG_EXYNOS_BCM_DBG=m
CONFIG_EXYNOS_MEMORY_LOGGER=m

CONFIG_EXYNOS_SWD=m

CONFIG_MCPS=m
CONFIG_EXYNOS_ACPM_PLGDBG=m
CONFIG_EXYNOS_DEBUG=y
CONFIG_DEBUG_SNAPSHOT=m
CONFIG_DEBUG_SNAPSHOT_SFRDUMP=m
CONFIG_DEBUG_SNAPSHOT_QUICKDUMP=m
CONFIG_EXYNOS_DEBUG_TEST=m
CONFIG_EXYNOS_ADV_TRACER=m
CONFIG_EXYNOS_ADV_TRACER_S2D=m
CONFIG_EXYNOS_ITMON=m
CONFIG_EXYNOS_CORESIGHT=m
CONFIG_EXYNOS_ECC_HANDLER=m
CONFIG_EXYNOS_EHLD=m
CONFIG_EXYNOS_HARDLOCKUP_WATCHDOG=m
CONFIG_EXYNOS_HARDLOCKUP_DEBUG=m
CONFIG_EXYNOS_SSLD=m
CONFIG_EXYNOS_MODEM_IF=m
CONFIG_SEC_MODEM_S5000AP=m
CONFIG_CP_PKTPROC=m
CONFIG_CP_BTL=m
CONFIG_HW_REV_DETECT=m
CONFIG_CPIF_TP_MONITOR=m
CONFIG_EXYNOS_DIT=m
CONFIG_CP_LLC=m
CONFIG_REINIT_VSS=m
CONFIG_VERIFY_VSS=m
CONFIG_S2MPS23_ADC=m
# CONFIG_GENERIC_PHY is not set
CONFIG_PWM_SAMSUNG=m
CONFIG_PHY_EXYNOS_MIPI=m
CONFIG_F2FS_FS_COMPRESSION=y
CONFIG_FSCRYPT_SDP=y
CONFIG_INCREMENTAL_FS=y
CONFIG_NTFS_FS=y
CONFIG_PSTORE_PMSG=y
CONFIG_LSM_MMAP_MIN_ADDR=4096
CONFIG_SDP=y
CONFIG_DDAR=y
CONFIG_SECURITY_DEFEX=y
CONFIG_PROCA=y
CONFIG_PROCA_S_OS=y
CONFIG_GAF_V6=y
CONFIG_SECURITY_DSMS=y
CONFIG_FIVE=y
CONFIG_FIVE_GKI_10=y
CONFIG_CRYPTO_FIPS=y
CONFIG_CRYPTO_CHACHA20POLY1305=y
CONFIG_CRYPTO_XCBC=y
CONFIG_EXYNOS_FMP=m
CONFIG_EXYNOS_FMP_FIPS=m
CONFIG_PRINTK_PROCESS=y
CONFIG_WQ_WATCHDOG=y
# CONFIG_RUNTIME_TESTING_MENU is not set
CONFIG_CC_WERROR=y
```

## drivers/gpu/arm/Kconfig
```kconfig
#
# (C) COPYRIGHT 2012 ARM Limited. All rights reserved.
#
# This program is free software and is provided to you under the terms of the
# GNU General Public License version 2 as published by the Free Software
# Foundation, and any use by you of this program is subject to the terms
# of such GNU licence.
#
# This program is distributed in the hope that it will be useful,
# but WITHOUT ANY WARRANTY; without even the implied warranty of
# MERCHANTABILITY or FITNESS FOR A PARTICULAR PURPOSE. See the
# GNU General Public License for more details.
#
# You should have received a copy of the GNU General Public License
# along with this program; if not, you can access it online at
# http://www.gnu.org/licenses/gpl-2.0.html.
#
# SPDX-License-Identifier: GPL-2.0
#
#

menu "ARM GPU Configuration"

choice
	prompt "Valhall driver version"
	default MALI_DDK_VALHALL_R38P0
	help
	  Select the ARM Mali Valhall DDK version to be built.

config MALI_DDK_VALHALL_R38P0
	bool "Valhall r38p0 driver"

config MALI_DDK_VALHALL_R38P1
	bool "Valhall r38p1 driver"

endchoice

if MALI_DDK_VALHALL_R38P0
source "drivers/gpu/arm/bv_r38p0/Kconfig"
endif

if MALI_DDK_VALHALL_R38P1
source "drivers/gpu/arm/bv_r38p1/Kconfig"
endif

endmenu
```

## drivers/gpu/drm/samsung/Kconfig
```kconfig
# SPDX-License-Identifier: GPL-2.0

if SOC_EXYNOS2100

source "drivers/gpu/drm/samsung/dpu30/Kconfig"
source "drivers/gpu/drm/samsung/panel/Kconfig"
source "drivers/gpu/drm/samsung/dp_logger/Kconfig"

endif
```

## drivers/misc/samsung/Kconfig
```kconfig
# SPDX-License-Identifier: GPL-2.0
#
comment "Samsung Miscellaneous Drivers"

config SEC_STI
	tristate "Samsung STI(System Test Infra)"
	default n
	help
		Config to support Samsung STI(System Test Infra) solutions.
		There are many sub configs to support
		ABC driver, ABC hub driver, LABO driver and so on.
		All sub configs depends on config SEC_STI.

config EXYNOS_PASR
	bool "Exynos PASR driver"
	depends on MEMORY_HOTPLUG && SOC_SAMSUNG
	help
	  This driver allows you to control PASR during suspend state.

config SEC_SENSOR
    tristate "Samsung SEC Sensor Driver"
    depends on SOC_SAMSUNG
    default y
    help
      Enable support for Samsung SEC sensor driver.

config SPU_VERIFY
	tristate "SPU Sign Verify Driver"
	default n
	help
	  This option enables SPU sign verify driver.
	  When SPU fireware update, image signature verify.
	  Each firmware is checked by calling a function before updating.
	  If disable config, maybe Signature checking cause problems.

config DEV_RIL_BRIDGE
	tristate "Support a bridge between device and RIL"
	default n

config TRUSTONIC_TEE
    tristate "Trustonic TEE Driver"
    depends on ARM || ARM64 && SOC_EXYNOS2100
    default m
    ---help---
      Enable Trustonic TEE support

menuconfig VISION_SUPPORT
	tristate "Vision Support"
	select VISION_CORE
	help
	  If you want to use hardware acceleration for vision
	  enable this option and other options below.

comment "MUIC configs"
config USE_MUIC
	bool "Using MUIC device driver"
	depends on I2C
	default n
	help
	  If you say yes here you will get support for
	  the MUIC device driver.

source "drivers/misc/samsung/sensors_lego/Kconfig"
source "drivers/misc/samsung/tui/Kconfig"
source "drivers/misc/samsung/tzdev/Kconfig"
source "drivers/misc/samsung/vision/Kconfig"
source "drivers/misc/samsung/abc/Kconfig"
source "drivers/misc/samsung/gud-exynos2100/Kconfig"
source "drivers/misc/samsung/bts/Kconfig"
source "drivers/misc/samsung/muic/Kconfig"
```
